## conf/layer.conf
```bitbake
# We have a conf and classes directory, add to BBPATH
BBPATH := "${LAYERDIR}:${BBPATH}"

# We have a recipes-* directories, add to BBFILES
BBFILES += "${LAYERDIR}/recipes-*/*/*.bb \
			${LAYERDIR}/recipes-*/*/*.bbappend"

BBFILE_COLLECTIONS += "dirhoe"
BBFILE_PATTERN_dirhoe := "^${LAYERDIR}/"
BBFILE_PRIORITY_dirhoe = "11"

#LAYERDEPENDS_dirhoe = "core stm-st-stm32mp"


# Set a variable to get the STM32MP BSP location
#STM32MP_BASE = "${LAYERDIR}"

# This should only be incremented on significant changes that will
# cause compatibility issues with other layers
LAYERVERSION_dirhoe = "1"
LAYERSERIES_COMPAT_dirhoe = "mickledore kirkstone"

# for optee-os-stm32mp dependency
#LAYERDEPENDS_dirhoe = "core stm-st-stm32mp"

# OpenSTLinux compatibility version
#ST_OSTL_COMPATIBILITY_VERSION_stm-st-stm32mp = "4.0 4.1"
```
